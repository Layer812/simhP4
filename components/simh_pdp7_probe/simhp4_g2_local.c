/*
 * simhP4 / RetroP4 integration
 * Copyright (c) 2026 simhP4 contributors
 *
 * Upstream SIMH-derived portions retain their original copyright notices
 * and license terms.  See LICENSES/SIMH_LICENSE.txt.
 */
#include "simhp4_probe.h"
#include "simhp4_type340_surface.h"

#include <stdio.h>
#include <string.h>

#include "freertos/FreeRTOS.h"
#include "freertos/queue.h"

#include "sim_defs.h"
#include "sim_tmxr.h"

/*
 * R0A3 local endpoint for the unmodified Open SIMH PDP-7 GRAPHICS-2 driver.
 *
 * unixv0.simh normally does:
 *   set g2in ena
 *   att -U g2in 12345
 *
 * That attach is only the host-side transport.  Guest-visible behavior lives
 * in PDP18B/pdp18b_g2tty.c.  On Tab5 we keep that exact device implementation
 * and replace only the TELNET transport with one permanently-connected local
 * endpoint:
 *
 *   CPU0 USB HID -> input queue -> tmxr_getc_ln() -> upstream g2in_svc()
 *   upstream G2OUT -> tmxr_putc_ln() -> output queue -> CPU0 M5GFX
 */

#define SIMHP4_G2_INPUT_DEPTH   128
#define SIMHP4_G2_OUTPUT_DEPTH  2048
#define SIMHP4_G2_CAPTURE_MAX   4096

static QueueHandle_t s_g2_input_queue = NULL;
static QueueHandle_t s_g2_output_queue = NULL;

static volatile uint32_t s_g2_input_drops = 0;
static volatile uint32_t s_g2_output_drops = 0;

static char s_g2_capture[SIMHP4_G2_CAPTURE_MAX];
static size_t s_g2_capture_len = 0;
static const char *s_g2_watch_needle = NULL;
static volatile int s_g2_watch_seen = 0;

int simhp4_g2_local_init(void)
{
    if (s_g2_input_queue == NULL)
        s_g2_input_queue = xQueueCreate(SIMHP4_G2_INPUT_DEPTH, sizeof(uint8_t));
    if (s_g2_output_queue == NULL)
        s_g2_output_queue = xQueueCreate(SIMHP4_G2_OUTPUT_DEPTH, sizeof(uint8_t));

    return (s_g2_input_queue != NULL && s_g2_output_queue != NULL) ? 1 : 0;
}

void simhp4_g2_local_reset(void)
{
    if (s_g2_input_queue != NULL)
        xQueueReset(s_g2_input_queue);
    if (s_g2_output_queue != NULL)
        xQueueReset(s_g2_output_queue);

    s_g2_input_drops = 0;
    s_g2_output_drops = 0;
    s_g2_capture_len = 0;
    s_g2_capture[0] = '\0';
    s_g2_watch_needle = NULL;
    s_g2_watch_seen = 0;
}

extern void simhp4_g2_button_pulse(unsigned logical_button);

/* SIMHP4_R0A9R19_SPACE_TRAVEL_KEY_ALIASES
 * Historical 1..8 controls remain authoritative.  While a captured GRAPHIC-II
 * program owns the display, Z/X are convenience aliases for PB6/PB7 (scale
 * up/down).  Cursor aliases are generated by the A164 host path in main.cpp so
 * ordinary GRAPHIC-II keyboard bytes remain untouched outside Space Travel. */
int simhp4_g2_host_enqueue(uint8_t ch)
{
    if (simhp4_type340_surface_is_active()) {
        if (ch >= (uint8_t)'1' && ch <= (uint8_t)'8') {
            simhp4_g2_button_pulse((unsigned)(ch - (uint8_t)'1'));
            return 1;
        }
        if (ch == (uint8_t)'z' || ch == (uint8_t)'Z') {
            simhp4_g2_button_pulse(6u);          /* PB6 = key 7 = scale up */
            return 1;
        }
        if (ch == (uint8_t)'x' || ch == (uint8_t)'X') {
            simhp4_g2_button_pulse(7u);          /* PB7 = key 8 = scale down */
            return 1;
        }
    }

    if (s_g2_input_queue == NULL)
        return 0;

    if (xQueueSend(s_g2_input_queue, &ch, 0) != pdTRUE) {
        ++s_g2_input_drops;
        return 0;
    }
    return 1;
}

int simhp4_g2_host_dequeue(uint8_t *ch)
{
    if (s_g2_output_queue == NULL || ch == NULL)
        return 0;
    return (xQueueReceive(s_g2_output_queue, ch, 0) == pdTRUE) ? 1 : 0;
}

int simhp4_g2_host_dequeue_wait(uint8_t *ch)
{
    if (s_g2_output_queue == NULL || ch == NULL)
        return 0;

    /* CPU0 presenter is event-driven.  Block until G2OUT produces a byte
     * instead of spinning/yielding at a higher priority than app_main/IDLE0. */
    return (xQueueReceive(s_g2_output_queue, ch, portMAX_DELAY) == pdTRUE) ? 1 : 0;
}

int simhp4_g2_host_dequeue_timed(uint8_t *ch, uint32_t timeout_ms)
{
    if (s_g2_output_queue == NULL || ch == NULL)
        return 0;

    return (xQueueReceive(s_g2_output_queue,
                          ch,
                          pdMS_TO_TICKS(timeout_ms)) == pdTRUE) ? 1 : 0;
}

uint32_t simhp4_g2_input_drop_count(void)
{
    return s_g2_input_drops;
}

uint32_t simhp4_g2_output_drop_count(void)
{
    return s_g2_output_drops;
}

void simhp4_g2_watch_begin(const char *needle)
{
    s_g2_watch_needle = needle;
    s_g2_watch_seen = 0;
}

int simhp4_g2_watch_hit(void)
{
    return s_g2_watch_seen;
}

const char *simhp4_g2_capture_get(void)
{
    return s_g2_capture;
}

static void simhp4_g2_capture_char(uint8_t ch)
{
    if (s_g2_capture_len + 1 < sizeof(s_g2_capture)) {
        s_g2_capture[s_g2_capture_len++] = (char)(ch & 0177);
        s_g2_capture[s_g2_capture_len] = '\0';
    }

    if (!s_g2_watch_seen &&
        s_g2_watch_needle != NULL &&
        s_g2_watch_needle[0] != '\0' &&
        strstr(s_g2_capture, s_g2_watch_needle) != NULL) {
        /* R0A5: checkpoint only.  Reaching the UNIX shell must never stop
         * sim_instr(); otherwise the first '@ ' prompt kills the live shell. */
        s_g2_watch_seen = 1;
    }
}

/* ------------------------------------------------------------------
 * Minimal local TMXR implementation required by pdp18b_g2tty.c.
 * ------------------------------------------------------------------ */

t_stat tmxr_attach_ex(TMXR *mp, UNIT *uptr, CONST char *cptr, t_bool async)
{
    TMLN *lp;
    (void)cptr;
    (void)async;

    if (mp == NULL || uptr == NULL || mp->lines < 1 || mp->ldsc == NULL)
        return SCPE_ARG;
    if (!simhp4_g2_local_init())
        return SCPE_MEM;

    lp = &mp->ldsc[0];

    mp->uptr = uptr;
    lp->mp = mp;
    lp->uptr = uptr;
    lp->o_uptr = uptr;

    lp->conn = 1;
    lp->rcve = 1;
    lp->xmte = 1;
    lp->notelnet = 1;
    lp->nomessage = 1;

    uptr->flags |= UNIT_ATT;
    return SCPE_OK;
}

t_stat tmxr_detach(TMXR *mp, UNIT *uptr)
{
    if (mp != NULL && mp->lines > 0 && mp->ldsc != NULL) {
        mp->ldsc[0].conn = 0;
        mp->ldsc[0].rcve = 0;
        mp->ldsc[0].xmte = 0;
    }
    if (uptr != NULL)
        uptr->flags &= ~UNIT_ATT;
    return SCPE_OK;
}

int32 tmxr_poll_conn(TMXR *mp)
{
    if (mp != NULL && mp->lines > 0 && mp->ldsc != NULL) {
        mp->ldsc[0].conn = 1;
        mp->ldsc[0].rcve = 1;
        mp->ldsc[0].xmte = 1;
    }
    return -1; /* local endpoint is already connected; no new connect event */
}

void tmxr_poll_rx(TMXR *mp)
{
    (void)mp;
}

void tmxr_poll_tx(TMXR *mp)
{
    if (mp != NULL && mp->lines > 0 && mp->ldsc != NULL)
        mp->ldsc[0].xmte = 1;
}

int32 tmxr_getc_ln(TMLN *lp)
{
    uint8_t ch = 0;

    if (lp == NULL || !lp->conn || !lp->rcve || s_g2_input_queue == NULL)
        return 0;

    if (xQueueReceive(s_g2_input_queue, &ch, 0) != pdTRUE)
        return 0;

    /* Match TMXR contract. pdp18b_g2tty.c masks this to 7-bit data and then
     * performs its original CR->LF and punctuation pre-swap translations. */
    return (int32)(TMXR_VALID | ch);
}

t_stat tmxr_putc_ln(TMLN *lp, int32 chr)
{
    uint8_t ch = (uint8_t)(chr & 0377);

    if (lp == NULL || !lp->conn || !lp->xmte)
        return SCPE_LOST;

    simhp4_g2_capture_char(ch);

    if (s_g2_output_queue != NULL) {
        if (xQueueSend(s_g2_output_queue, &ch, 0) != pdTRUE)
            ++s_g2_output_drops;
    } else {
        ++s_g2_output_drops;
    }

    return SCPE_OK;
}

/* SCP-only helpers referenced by G2 DEVICE/MTAB tables.
 * They are not used by the embedded boot path, but keeping stubs local avoids
 * pulling the desktop socket/TELNET implementation into the firmware. */
t_stat tmxr_ex(t_value *vptr, t_addr addr, UNIT *uptr, int32 sw)
{
    (void)vptr; (void)addr; (void)uptr; (void)sw;
    return SCPE_OK;
}

t_stat tmxr_dep(t_value val, t_addr addr, UNIT *uptr, int32 sw)
{
    (void)val; (void)addr; (void)uptr; (void)sw;
    return SCPE_OK;
}

t_stat tmxr_show_summ(FILE *st, UNIT *uptr, int32 val, CONST void *desc)
{
    (void)uptr; (void)val; (void)desc;
    if (st != NULL)
        fprintf(st, "local Tab5 endpoint");
    return SCPE_OK;
}

t_stat tmxr_dscln(UNIT *uptr, int32 val, CONST char *cptr, void *desc)
{
    TMXR *mp = (TMXR *)desc;
    (void)uptr; (void)val; (void)cptr;
    if (mp != NULL && mp->lines > 0 && mp->ldsc != NULL) {
        mp->ldsc[0].conn = 0;
        mp->ldsc[0].rcve = 0;
        mp->ldsc[0].xmte = 0;
    }
    return SCPE_OK;
}

t_stat tmxr_show_cstat(FILE *st, UNIT *uptr, int32 val, CONST void *desc)
{
    (void)uptr; (void)val; (void)desc;
    if (st != NULL)
        fprintf(st, "local=connected");
    return SCPE_OK;
}

t_stat tmxr_set_log(UNIT *uptr, int32 val, CONST char *cptr, void *desc)
{
    (void)uptr; (void)val; (void)cptr; (void)desc;
    return SCPE_OK;
}

t_stat tmxr_show_log(FILE *st, UNIT *uptr, int32 val, CONST void *desc)
{
    (void)uptr; (void)val; (void)desc;
    if (st != NULL)
        fprintf(st, "no local log");
    return SCPE_OK;
}

t_stat tmxr_set_nolog(UNIT *uptr, int32 val, CONST char *cptr, void *desc)
{
    (void)uptr; (void)val; (void)cptr; (void)desc;
    return SCPE_OK;
}
