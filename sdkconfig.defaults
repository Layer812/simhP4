## sdkconfig.defaults
```kconfig
# SIMHP4 R0A0
# Derived from the proven X68K Tab / ESP-IDF 5.5.4 Tab5 production host profile.
CONFIG_ESP_MAIN_TASK_AFFINITY_CPU0=y
CONFIG_ESP_MAIN_TASK_AFFINITY=0x0
CONFIG_ESP_MAIN_TASK_STACK_SIZE=12288
CONFIG_ESP_TASK_WDT_TIMEOUT_S=15
CONFIG_IDF_EXPERIMENTAL_FEATURES=y

CONFIG_SPIRAM=y
CONFIG_SPIRAM_MODE_HEX=y
CONFIG_SPIRAM_SPEED_200M=y
CONFIG_SPIRAM_BOOT_INIT=y
CONFIG_SPIRAM_USE_MALLOC=y
CONFIG_SPIRAM_ALLOW_BSS_SEG_EXTERNAL_MEMORY=y
CONFIG_SPIRAM_MALLOC_RESERVE_INTERNAL=32768

CONFIG_CACHE_L2_CACHE_128KB=y
CONFIG_CACHE_L2_CACHE_SIZE=0x20000
CONFIG_CACHE_L2_CACHE_LINE_64B=y
CONFIG_CACHE_L2_CACHE_LINE_SIZE=64

CONFIG_ESPTOOLPY_FLASHSIZE_16MB=y
CONFIG_ESPTOOLPY_FLASHSIZE="16MB"
CONFIG_ESPTOOLPY_FLASHMODE_QIO=y
CONFIG_ESPTOOLPY_FLASHMODE="qio"
CONFIG_ESPTOOLPY_FLASHFREQ_80M=y
CONFIG_ESPTOOLPY_FLASHFREQ_VAL=80
CONFIG_ESPTOOLPY_FLASHFREQ="80m"

CONFIG_PARTITION_TABLE_CUSTOM=y
CONFIG_PARTITION_TABLE_CUSTOM_FILENAME="partitions.csv"
CONFIG_PARTITION_TABLE_FILENAME="partitions.csv"

CONFIG_ESP32P4_SELECTS_REV_LESS_V3=y
CONFIG_ESP32P4_REV_MIN_1=y
CONFIG_ESP_DEFAULT_CPU_FREQ_MHZ_360=y
CONFIG_ESP_DEFAULT_CPU_FREQ_MHZ=360
CONFIG_COMPILER_OPTIMIZATION_PERF=y
CONFIG_COMPILER_DISABLE_DEFAULT_ERRORS=y
```
